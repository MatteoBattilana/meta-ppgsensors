## conf/layer.conf
```bitbake
# We have a conf and classes directory, add to BBPATH
BBPATH .= ":${LAYERDIR}"

# We have recipes-* directories, add to BBFILES
BBFILES += "${LAYERDIR}/recipes-*/*/*.bb \
            ${LAYERDIR}/recipes-*/*/*.bbappend"

BBFILE_COLLECTIONS += "meta-ppgsensors"
BBFILE_PATTERN_meta-ppgsensors = "^${LAYERDIR}/"
BBFILE_PRIORITY_meta-ppgsensors = "6"

LAYERDEPENDS_meta-ppgsensors = "core"
LAYERSERIES_COMPAT_meta-ppgsensors = "dunfell"
```
